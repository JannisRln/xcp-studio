ASAP2_VERSION 1 71
/begin PROJECT interface_fixture "Synthetic A2ML fixture"
/begin MODULE gateway ""
/begin IF_DATA 0x1234 /end IF_DATA
/end MODULE
/end PROJECT
